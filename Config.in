## Config.in
```kconfig
source "$BR2_EXTERNAL_LINUXCARD_PATH/package/linuxcard-flashdrive/Config.in"
source "$BR2_EXTERNAL_LINUXCARD_PATH/package/2048/Config.in"
source "$BR2_EXTERNAL_LINUXCARD_PATH/package/rogue/Config.in"
source "$BR2_EXTERNAL_LINUXCARD_PATH/package/librecode/Config.in"
```

## configs/linuxcard_defconfig
```kconfig
BR2_arm=y
BR2_ARM_INSTRUCTIONS_THUMB=y
BR2_SVN="svn"
BR2_CCACHE=y
BR2_SHARED_STATIC_LIBS=y
BR2_GLOBAL_PATCH_DIR="$(BR2_EXTERNAL_LINUXCARD_PATH)/patches"
BR2_TOOLCHAIN_BUILDROOT_WCHAR=y
# BR2_UCLIBC_INSTALL_UTILS is not set
BR2_TOOLCHAIN_BUILDROOT_CXX=y
BR2_TARGET_GENERIC_HOSTNAME="Linux_Card"
BR2_TARGET_GENERIC_ISSUE="Welcome to wzj linuxcard!"
BR2_ROOTFS_DEVICE_CREATION_DYNAMIC_MDEV=y
BR2_ROOTFS_MERGED_USR=y
BR2_TARGET_GENERIC_GETTY_PORT="/dev/ttyS0"
BR2_TARGET_GENERIC_GETTY_BAUDRATE_115200=y
BR2_ROOTFS_OVERLAY="$(BR2_EXTERNAL_LINUXCARD_PATH)/board/linuxcard/rootfs_overlay"
BR2_ROOTFS_POST_BUILD_SCRIPT="$(BR2_EXTERNAL_LINUXCARD_PATH)/board/linuxcard/v1/post-build.sh"
BR2_ROOTFS_POST_IMAGE_SCRIPT="support/scripts/genimage.sh"
BR2_ROOTFS_POST_SCRIPT_ARGS="-c $(BR2_EXTERNAL_LINUXCARD_PATH)/board/linuxcard/v1/genimage.cfg"
BR2_LINUX_KERNEL=y
BR2_LINUX_KERNEL_CUSTOM_GIT=y
BR2_LINUX_KERNEL_CUSTOM_REPO_URL="git://github.com/wang-zejun/linux.git"
BR2_LINUX_KERNEL_CUSTOM_REPO_VERSION="0258e33350a156ae82c2fe49f58ea63b6fc459e6"
BR2_LINUX_KERNEL_USE_CUSTOM_CONFIG=y
BR2_LINUX_KERNEL_CUSTOM_CONFIG_FILE="$(BR2_EXTERNAL_LINUXCARD_PATH)/board/linuxcard/v1/linux_defconfig"
BR2_LINUX_KERNEL_DTS_SUPPORT=y
BR2_LINUX_KERNEL_CUSTOM_DTS_PATH="$(BR2_EXTERNAL_LINUXCARD_PATH)/board/linuxcard/v1/dts/linuxcard.dts"
BR2_PACKAGE_DHRYSTONE=y
BR2_PACKAGE_STRESS=y
BR2_PACKAGE_MTD=y
BR2_PACKAGE_MICROPYTHON=y
BR2_PACKAGE_MICROPYTHON_LIB=y
BR2_PACKAGE_LIBTIRPC=y
BR2_TARGET_ROOTFS_JFFS2=y
BR2_TARGET_ROOTFS_JFFS2_FLASH_64=y
BR2_TARGET_ROOTFS_JFFS2_NOCLEANMARKER=y
BR2_TARGET_ROOTFS_JFFS2_PAD=y
BR2_TARGET_ROOTFS_JFFS2_PADSIZE=0xA00000
BR2_TARGET_ROOTFS_JFFS2_USE_CUSTOM_PAGESIZE=y
BR2_TARGET_ROOTFS_JFFS2_CUSTOM_PAGESIZE=0x100
BR2_TARGET_ROOTFS_SQUASHFS=y
# BR2_TARGET_ROOTFS_SQUASHFS_PAD is not set
BR2_TARGET_ROOTFS_SQUASHFS4_XZ=y
BR2_TARGET_UBOOT=y
BR2_TARGET_UBOOT_BUILD_SYSTEM_KCONFIG=y
BR2_TARGET_UBOOT_CUSTOM_GIT=y
BR2_TARGET_UBOOT_CUSTOM_REPO_URL="git://github.com/wang-zejun/u-boot.git"
BR2_TARGET_UBOOT_CUSTOM_REPO_VERSION="c0ff302fa622ce5081c49ef573e0f4b125bb1e77"
BR2_TARGET_UBOOT_USE_CUSTOM_CONFIG=y
BR2_TARGET_UBOOT_CUSTOM_CONFIG_FILE="$(BR2_EXTERNAL_LINUXCARD_PATH)/board/linuxcard/v1/uboot_defconfig"
BR2_TARGET_UBOOT_NEEDS_DTC=y
BR2_TARGET_UBOOT_NEEDS_PYTHON3=y
BR2_TARGET_UBOOT_NEEDS_PYLIBFDT=y
# BR2_TARGET_UBOOT_FORMAT_BIN is not set
BR2_TARGET_UBOOT_FORMAT_CUSTOM=y
BR2_TARGET_UBOOT_FORMAT_CUSTOM_NAME="u-boot-sunxi-with-spl.bin"
BR2_TARGET_UBOOT_CUSTOM_DTS_PATH="$(BR2_EXTERNAL_LINUXCARD_PATH)/board/linuxcard/v1/dts/*"
BR2_PACKAGE_HOST_MKPASSWD=y
BR2_PACKAGE_HOST_MTD=y
BR2_PACKAGE_LINUXCARD_FLASHDRIVE=y
```

## package/linuxcard-flashdrive/Config.in
```kconfig
config BR2_PACKAGE_LINUXCARD_FLASHDRIVE
	bool "linuxcard-flashdrive"
	select BR2_PACKAGE_HOST_GENIMAGE
	select BR2_PACKAGE_HOST_DOSFSTOOLS
	select BR2_PACKAGE_HOST_MTOOLS
	help
	  The "flash drive" image that appears when you plug my linux card into
	  a PC.

	  https://github.com/wang-zejun
```
